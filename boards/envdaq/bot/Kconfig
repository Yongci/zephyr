## boards/envdaq/bot/Kconfig
```kconfig
# Copyright (c) 2026 Yongci
# SPDX-License-Identifier: Apache-2.0

config HEAP_MEM_POOL_ADD_SIZE_BOARD
	int
	default 4096 if BOARD_ENVDAQ_BOT_ESP32C6_HPCORE
	default 256 if BOARD_ENVDAQ_BOT_ESP32C6_LPCORE
```

## boards/envdaq/bot/Kconfig.envdaq_bot
```kconfig
# EnvDaq bot
# Copyright (c) 2026 Yongci
# SPDX-License-Identifier: Apache-2.0

config BOARD_ENVDAQ_BOT
	select SOC_ESP32_C6_WROOM_1U_N4
	select SOC_ESP32C6_HPCORE if BOARD_ENVDAQ_BOT_ESP32C6_HPCORE
	select SOC_ESP32C6_LPCORE if BOARD_ENVDAQ_BOT_ESP32C6_LPCORE
```

## boards/envdaq/bot/Kconfig.sysbuild
```kconfig
# Copyright (c) 2023 Espressif Systems (Shanghai) Co., Ltd.
# Copyright (c) 2026 Yongci
# SPDX-License-Identifier: Apache-2.0

choice BOOTLOADER
	default BOOTLOADER_MCUBOOT
endchoice

choice BOOT_SIGNATURE_TYPE
	default BOOT_SIGNATURE_TYPE_NONE
endchoice
```

## boards/envdaq/bot/board.yml
```yaml
board:
  name: envdaq_bot
  full_name: EnvDAQ Bot
  vendor: EnvDAQ
  socs:
    - name: esp32c6
```

## dts/bindings/usb/wch,ch224q.yaml
```yaml
# Copyright (c) 2026 Yongci

# SPDX-License-Identifier: Apache-2.0

description: WCH CH224Q USB PD Sink Controller

compatible: "wch,ch224q"

include: [i2c-device.yaml]

properties:
  int-gpios:
    type: phandle-array
    required: false
    description: |
      GPIO connected to the INT pin of CH224Q (CFG1 pin when used as interrupt).
      This pin signals when a PD negotiation is complete or status changed.

  pg-gpios:
    type: phandle-array
    required: false
    description: |
      GPIO connected to the PG (Power Good) pin of CH224Q.
      This pin is open-drain, active low. It is pulled low when voltage
      negotiation is successful and the output voltage is stable.

  cfg2-gpios:
    type: phandle-array
    required: false
    description: |
      GPIO connected to CFG2 pin for voltage selection in hardware mode.

  cfg3-gpios:
    type: phandle-array
    required: false
    description: |
      GPIO connected to CFG3 pin for voltage selection in hardware mode.

  mode:
    type: string
    required: false
    default: "i2c"
    description: |
      Operating mode: "i2c" for I2C control, "gpio" for GPIO voltage selection.

  voltage-request:
    type: int
    required: false
    default: 5000
    description: |
      Default requested voltage in mV when in GPIO mode.
      Valid values: 5000, 9000, 12000, 15000, 20000, 28000.
```
